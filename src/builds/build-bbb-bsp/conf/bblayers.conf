## src/builds/build-bbb-bsp/conf/bblayers.conf
```bitbake
# POKY_BBLAYERS_CONF_VERSION is increased each time build/conf/bblayers.conf
# changes incompatibly
POKY_BBLAYERS_CONF_VERSION = "2"

BBPATH = "${TOPDIR}"
BBFILES ?= ""

BBLAYERS ?= " \
  /home/yocto/workspace/.tmp/poky/meta \
  /home/yocto/workspace/.tmp/poky/meta-poky \
  /home/yocto/workspace/.tmp/poky/meta-yocto-bsp \
  /home/yocto/workspace/src/layers/meta-bbb-bsp \
  /home/yocto/workspace/src/builds/build-bbb-bsp/workspace \
  "
```

## src/builds/build-bbb-bsp/conf/local.conf
```bitbake
#
# This file is your local configuration file and is where all local user settings
# are placed. The comments in this file give some guide to the options a new user
# to the system might want to change but pretty much any configuration option can
# be set in this file. More adventurous users can look at
# local.conf.sample.extended which contains other examples of configuration which
# can be placed in this file but new users likely won't need any of them
# initially. There's also site.conf.sample which contains examples of site specific
# information such as proxy server addresses.
#
# Lines starting with the '#' character are commented out and in some cases the
# default values are provided as comments to show people example syntax. Enabling
# the option is a question of removing the # character and making any change to the
# variable as required.

MACHINE ??= "bbb-custom"

DL_DIR ?= "${TOPDIR}/../../tmp/downloads"
SSTATE_DIR ?= "${TOPDIR}/../../tmp/sstate-cache"

DISTRO ?= "poky"
EXTRA_IMAGE_FEATURES ?= "debug-tweaks"

USER_CLASSES ?= "buildstats"

PATCHRESOLVE = "noop"

BB_DISKMON_DIRS ??= "\
    STOPTASKS,${TMPDIR},1G,100K \
    STOPTASKS,${DL_DIR},1G,100K \
    STOPTASKS,${SSTATE_DIR},1G,100K \
    STOPTASKS,/tmp,100M,100K \
    HALT,${TMPDIR},100M,1K \
    HALT,${DL_DIR},100M,1K \
    HALT,${SSTATE_DIR},100M,1K \
    HALT,/tmp,10M,1K"

PACKAGECONFIG:append:pn-qemu-system-native = " sdl"

IMAGE_FSTYPES:append = " wic wic.bmap"

CONF_VERSION = "2"
```

## src/layers/meta-anhle/conf/layer.conf
```bitbake
# We have a conf and classes directory, add to BBPATH
BBPATH .= ":${LAYERDIR}"

# We have recipes-* directories, add to BBFILES
BBFILES += "${LAYERDIR}/recipes-*/*/*.bb \
            ${LAYERDIR}/recipes-*/*/*.bbappend"

BBFILE_COLLECTIONS += "meta-anhle"
BBFILE_PATTERN_meta-anhle = "^${LAYERDIR}/"
BBFILE_PRIORITY_meta-anhle = "6"

LAYERDEPENDS_meta-anhle = "core"
LAYERSERIES_COMPAT_meta-anhle = "wrynose"
```

## src/layers/meta-bbb-bsp/conf/machine/bbb-custom.conf
```bitbake
#@TYPE: Machine
#@NAME: bbb-custom
#@DESCRIPTION: Custom Machine configuration for BeagleBone Black

require conf/machine/beaglebone-yocto.conf

MACHINEOVERRIDES =. "beaglebone-yocto:"
```
